/*
 * Copyright (c) 2025 STMicroelectronics
 *
 * SPDX-License-Identifier: Apache-2.0
 */

#include <st/mp2/stm32mp2_a35.dtsi>

/ {

	soc {

		compatible = "st,stm32mp257", "st,stm32mp2", "simple-bus";

	};
};
