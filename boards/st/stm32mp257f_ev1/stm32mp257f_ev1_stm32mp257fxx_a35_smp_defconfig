## boards/st/stm32mp257f_ev1/stm32mp257f_ev1_stm32mp257fxx_a35_smp_defconfig
```kconfig
# Copyright (c) 2025, STMicroelectronics

# SPDX-License-Identifier: Apache-2.0

# enable GPIO
CONFIG_GPIO=y

# Enable HW stack protection
CONFIG_HW_STACK_PROTECTION=n

# enable uart driver
CONFIG_SERIAL=y
CONFIG_UART_INTERRUPT_DRIVEN=y

# console (remote proc console by default)
CONFIG_CONSOLE=y

# uart console (overrides remote proc console)
CONFIG_UART_CONSOLE=y
```

## dts/bindings/clock/st,stm32mp2-pll-clock.yaml
```yaml
# Copyright (c) 2025 STMicroelectronics
# SPDX-License-Identifier: Apache-2.0

description: |
  PLL node binding for STM32MP2 devices

  It can be used to describe 8 different PLLs: PLL1 to PLL8

  These PLLs can take one of hse_ck, hsi_ck or msi_ck as input clock.
  PLLM factor is used to set the input clock in this acceptable range.

  Each PLL has one output clock whose frequency can be computed with the
  following formula:

    f(PLLx) = (f(PLLx_REF) x FBDIVx) / (FREFDIVx × POSTDIV1_x × POSTDIV2_x)


  Note: To reduce the power consumption, it is recommended to configure the PLLx
        clock output to the lowest frequency.

  The PLL output frequency must not exceed 3200 MHz.

  Note: The CPU clock should not exceed 1.5Ghz so avoid configuring the PLL1 to more
  than 1500 MHz
  (refer to the stm32mp2 reference manual for details)

compatible: "st,stm32mp2-pll-clock"

include: [clock-controller.yaml, base.yaml]

properties:

  "#clock-cells":
    const: 0

  clocks:
    required: true

  frefdiv:
    type: int
    required: true
    description: |
        Prescaler for PLLx
        input clock
        Valid range: 1 - 63

  fbdiv:
    type: int
    required: true
    description: |
        PLLx multiplication factor
        Valid range: 16 - 2500

  postdiv_1:
    type: int
    description: |
        PLLx POSTDIV1_x division factor
        Valid range: 1 - 7

  postdiv_2:
    type: int
    description: |
        PLLx POSTDIV2_x division factor
        Valid range: 1 - 7
```

## dts/bindings/clock/st,stm32mp2-stgen-clock-mux.yaml
```yaml
# Copyright (c) 2025, STMicroelectronics
# SPDX-License-Identifier: Apache-2.0

description: |
  STM32MP2 CPU Clock

  Describes the STM32MP2 STGEN clock multiplexer. On STM32MP2, this is the STGEN
  clock that feeds the SysTick.

  For instance:
  cpusw: cpusw {
    #clock-cells = <0>;
    clocks = <&clk_hsi>;
    clock-frequency = <DT_FREQ_M(64)>;
    compatible = "st,stm32mp2-stgen-clock-mux", "st,stm32-clock-mux";
    status = "okay";
  };

compatible: "st,stm32mp2-stgen-clock-mux"

include:
  - name: base.yaml
    property-allowlist:
      - status
      - compatible
      - clocks

properties:
  clock-frequency:
    required: true
    type: int
    description: |
      default frequency in Hz for the timer
```

## dts/bindings/ethernet/st,stm32c5-ethernet.yaml
```yaml
# Copyright (c) 2026, STMicroelectronics
# SPDX-License-Identifier: Apache-2.0

description: |
  STM32C5 Ethernet

  This binding file describes the device tree properties required to configure
  and use the Ethernet controller on STM32C5 microcontrollers.
  The `st,stm32c5-ethernet` compatible string can be used for both series,
  ensuring flexibility and ease of configuration.

compatible: "st,stm32c5-ethernet"

include: st,stm32-ethernet-common.yaml
```

## soc/st/stm32/stm32mp2x/Kconfig
```kconfig
# STMicroelectronics STM32MP2 MPU series
#
# Copyright (C) 2025 Savoir-faire Linux, Inc.
# Copyright (c) 2025 STMicroelectronics
# SPDX-License-Identifier: Apache-2.0

config SOC_SERIES_STM32MP2X
	select ARM
	select CPU_HAS_FPU
	select HAS_STM32CUBE

config SOC_STM32MP2X_M33
	select ARMV8_M_DSP
	select ARM_TRUSTZONE_M
	select CPU_CORTEX_M33
	select CPU_CORTEX_M_HAS_DWT
	select CPU_HAS_ARM_MPU
	select CPU_HAS_ARM_SAU

config SOC_STM32MP2X_A35
	bool
	select CPU_CORTEX_A35
	select CACHE_MANAGEMENT
	select SOC_EARLY_INIT_HOOK
	select SOC_PER_CORE_INIT_HOOK
	select ARM_ARCH_TIMER
	select SYS_CLOCK_EXISTS

config SOC_STM32MP2X_A35_SMP
	bool
	select CPU_CORTEX_A35
	select CACHE_MANAGEMENT
	select SOC_EARLY_INIT_HOOK
	select SOC_PER_CORE_INIT_HOOK
	select ARM_ARCH_TIMER
	select SYS_CLOCK_EXISTS
```

## soc/st/stm32/stm32mp2x/Kconfig.defconfig
```kconfig
# STMicroelectronics STM32MP2 MPU series
#
# Copyright (C) 2025 Savoir-faire Linux, Inc.
# Copyright (c) 2025 STMicroelectronics
# SPDX-License-Identifier: Apache-2.0

if SOC_SERIES_STM32MP2X

rsource "Kconfig.defconfig.stm32mp2*"

if SOC_STM32MP2X_A35 || SOC_STM32MP2X_A35_SMP

config CACHE_MANAGEMENT
	default y

DT_STM32_CPU_CLOCK_PATH := $(dt_nodelabel_path,stgen)
DT_STM32_CPU_CLOCK_FREQ := $(dt_node_int_prop_int,$(DT_STM32_CPU_CLOCK_PATH),clock-frequency)

# For STM32MP2, override the default value defined in STM32 Kconfig
config SYS_CLOCK_HW_CYCLES_PER_SEC
	default $(DT_STM32_CPU_CLOCK_FREQ) if $(dt_nodelabel_enabled,stgen)

endif # SOC_STM32MP2X_A35 || SOC_STM32MP2X_A35_SMP

endif # SOC_SERIES_STM32MP2X
```

## soc/st/stm32/stm32mp2x/Kconfig.defconfig.stm32mp257fxx
```kconfig
# STMicroelectronics STM32MP2 MPU series
#
# Copyright (C) 2025 Savoir-faire Linux, Inc.
# Copyright (c) 2025 STMicroelectronics
# SPDX-License-Identifier: Apache-2.0

if SOC_STM32MP2X_M33

config NUM_IRQS
	default 320

endif # SOC_STM32MP2X_M33

if SOC_STM32MP2X_A35 || SOC_STM32MP2X_A35_SMP

if SOC_STM32MP2X_A35_SMP

config SMP
	default y

config MP_MAX_NUM_CPUS
	default 2 if SMP

config USE_SWITCH
	default y

endif #SOC_STM32MP2X_A35_SMP

config NUM_IRQS
	default 415

endif # SOC_STM32MP2X_A35 || SOC_STM32MP2X_A35_SMP
```
